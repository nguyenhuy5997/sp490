#! armcc -E

#include "RTE/Device/SP49_B21/FlConfig.h"
	
; *************************************************************
; *** Scatter-Loading Description File generated by uVision ***
; *************************************************************
LR_FLASH_CONFIG (FL_CONFIG_START_ADDR) (FL_CONFIG_CONFIGLINE_SIZE)
{
	FLASH_CONFIG_LINE(0x10000800) (FL_CONFIG_CONFIGLINE_SIZE)
	{
		.ANY (FLASH_CONFIG)
	}
}
LR_FLASH_BOOT (FL_CONFIG_BOOT_START_ADDR) (FL_CONFIG_BOOT_SIZE)
{
	FLASH_BOOT(FL_CONFIG_START_ADDR + FL_CONFIG_CONFIGLINE_SIZE) (FL_CONFIG_BOOT_SIZE)
	{
		*.o (RESET, +First)
		*(InRoot$$Sections)
		.ANY (+XO +RO)
	}
}
#if (FL_CONFIG_NUM_UCS_SEC > 0)
LR_FLASH_UCS1 (FL_CONFIG_UCS_START_ADDR) (FL_CONFIG_SECT_SIZE-4)
{
	FLASH_UCS1 (FL_CONFIG_UCS_START_ADDR) (FL_CONFIG_SECT_SIZE-4)
	{
		.ANY (UCS1_CONTENT)
	}
}
LR_FLASH_UCS1_CRCLOCKBYTE (FL_CONFIG_UCS_START_ADDR+FL_CONFIG_SECT_SIZE-4) (4)
{
	FLASH_UCS1_CRCLOCKBYTE (FL_CONFIG_UCS_START_ADDR+FL_CONFIG_SECT_SIZE-4) (4)
	{
		.ANY (UCS1_CRCLB)
	}
}
#endif
#if (FL_CONFIG_NUM_UCS_SEC > 1)
LR_FLASH_UCS2 (FL_CONFIG_UCS_START_ADDR + FL_CONFIG_SECT_SIZE) (FL_CONFIG_SECT_SIZE-4)
{
	FLASH_UCS2 (FL_CONFIG_UCS_START_ADDR + FL_CONFIG_SECT_SIZE) (FL_CONFIG_SECT_SIZE-4)
	{
		.ANY (UCS2_CONTENT)
	}
}
LR_FLASH_UCS2_CRCLOCKBYTE (FL_CONFIG_UCS_START_ADDR+FL_CONFIG_SECT_SIZE * 2 -4) (4)
{
	FLASH_UCS2_CRCLOCKBYTE (FL_CONFIG_UCS_START_ADDR+FL_CONFIG_SECT_SIZE * 2 -4) (4)
	{
		.ANY (UCS2_CRCLB)
	}
}
#endif
#if (FL_CONFIG_NUM_UCS_SEC > 2)
LR_FLASH_UCS3(FL_CONFIG_UCS_START_ADDR + FL_CONFIG_SECT_SIZE * 2) (FL_CONFIG_SECT_SIZE-4)
{
	FLASH_UCS3 (FL_CONFIG_UCS_START_ADDR + FL_CONFIG_SECT_SIZE * 2) (FL_CONFIG_SECT_SIZE-4)
	{
		.ANY (UCS3_CONTENT)
	}
}
LR_FLASH_UCS3_CRCLOCKBYTE (FL_CONFIG_UCS_START_ADDR+FL_CONFIG_SECT_SIZE * 3 -4) (4)
{
	FLASH_UCS3_CRCLOCKBYTE (FL_CONFIG_UCS_START_ADDR+FL_CONFIG_SECT_SIZE * 3 -4) (4)
	{
		.ANY (UCS3_CRCLB)
	}
}
#endif
#if (FL_CONFIG_NUM_UCS_SEC > 3)
LR_FLASH_UCS4(FL_CONFIG_UCS_START_ADDR + FL_CONFIG_SECT_SIZE * 3) (FL_CONFIG_SECT_SIZE-4)
{
	FLASH_UCS4 (FL_CONFIG_UCS_START_ADDR + FL_CONFIG_SECT_SIZE * 3) (FL_CONFIG_SECT_SIZE-4)
	{
		.ANY (UCS4_CONTENT)
	}
}
LR_FLASH_UCS4_CRCLOCKBYTE (FL_CONFIG_UCS_START_ADDR+FL_CONFIG_SECT_SIZE * 4 -4) (4)
{
	FLASH_UCS4_CRCLOCKBYTE (FL_CONFIG_UCS_START_ADDR+FL_CONFIG_SECT_SIZE * 4 -4) (4)
	{
		.ANY (UCS4_CRCLB)
	}
}
#endif
#if (FL_CONFIG_NUM_UCS_SEC > 4)
LR_FLASH_UCS5(FL_CONFIG_UCS_START_ADDR + FL_CONFIG_SECT_SIZE * 4) (FL_CONFIG_SECT_SIZE-4)
{
	FLASH_UCS5 (FL_CONFIG_UCS_START_ADDR + FL_CONFIG_SECT_SIZE * 4) (FL_CONFIG_SECT_SIZE-4)
	{
		.ANY (UCS5_CONTENT)
	}
}
LR_FLASH_UCS5_CRCLOCKBYTE (FL_CONFIG_UCS_START_ADDR+FL_CONFIG_SECT_SIZE * 5 -4) (4)
{
	FLASH_UCS5_CRCLOCKBYTE (FL_CONFIG_UCS_START_ADDR+FL_CONFIG_SECT_SIZE * 5 -4) (4)
	{
		.ANY (UCS5_CRCLB)
	}
}
#endif
#if (FL_CONFIG_NUM_UCS_SEC > 5)
LR_FLASH_UCS6(FL_CONFIG_UCS_START_ADDR + FL_CONFIG_SECT_SIZE * 5) (FL_CONFIG_SECT_SIZE-4)
{
	FLASH_UCS6 (FL_CONFIG_UCS_START_ADDR + FL_CONFIG_SECT_SIZE * 5) (FL_CONFIG_SECT_SIZE-4)
	{
		.ANY (UCS6_CONTENT)
	}
}
LR_FLASH_UCS6_CRCLOCKBYTE (FL_CONFIG_UCS_START_ADDR+FL_CONFIG_SECT_SIZE * 6 -4) (4)
{
	FLASH_UCS6_CRCLOCKBYTE (FL_CONFIG_UCS_START_ADDR+FL_CONFIG_SECT_SIZE * 6 -4) (4)
	{
		.ANY (UCS6_CRCLB)
	}
}
#endif
LR_FLASH_CODE (FL_CONFIG_CODE_START_ADDR) (FL_CONFIG_CODE_SIZE-4)
{
	FLASH_CODE (FL_CONFIG_CODE_START_ADDR) (FL_CONFIG_CODE_SIZE-4)
	{
		.ANY (+XO +RO)
	}
	
	//RAM region follows
	RAM_STACK (0x20000000) UNINIT (0x200)
	{
		*.o (STACK, +FIRST)
	}
	RAM_GLOB_VARS (0x20000200) UNINIT (0x200)
	{
		.ANY (+RW +ZI)
	}
	
	//Retention RAM region follows
	RET_RAM_CUST (0x30000000) UNINIT (0xC0)
	{
		.ANY (RETRAM)
	}
}
LR_FLASH_CODE_CRCLOCKBYTE (FL_CONFIG_CODE_START_ADDR+FL_CONFIG_CODE_SIZE-4) (4)
{
	FLASH_CODE_CRCLOCKBYTE (FL_CONFIG_CODE_START_ADDR+FL_CONFIG_CODE_SIZE-4) (4)
	{
		.ANY (CODE_CRCLB)
	}
}
